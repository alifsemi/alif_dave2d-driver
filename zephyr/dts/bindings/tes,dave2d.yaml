## zephyr/dts/bindings/tes,dave2d.yaml
```yaml
# SPDX-License-Identifier: Apache-2.0
# Copyright (c) 2026 Alif Semiconductor

description: TES D/AVE 2D Graphics Accelerator

compatible: "tes,dave2d"

include: [base.yaml]

properties:
  reg:
    required: true

  interrupts:
    required: true

  clocks:
    required: true
```
